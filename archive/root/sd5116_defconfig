## archive/root/sd5116_defconfig
```kconfig
# SD5116 minimal kernel config
# Target: boot to console output on serial

# ARM platform
CONFIG_ARM=y
CONFIG_ARCH_MULTI_V7=y
CONFIG_ARCH_HISI=y
CONFIG_CPU_V7=y
CONFIG_ARM_THUMB=y
CONFIG_ARM_GIC=y
CONFIG_HAVE_ARM_SCU=y
CONFIG_ARM_GLOBAL_TIMER=y
CONFIG_ARM_TWD=y
CONFIG_USE_OF=y
CONFIG_OF=y
CONFIG_ATAGS=y
CONFIG_ARM_APPENDED_DTB=y
CONFIG_ARM_ATAG_DTB_COMPAT=y

# Memory
CONFIG_PHYS_OFFSET=0x80000000
CONFIG_PAGE_OFFSET=0xC0000000
CONFIG_HIGHMEM=n
CONFIG_FLATMEM=y

# Console / TTY
CONFIG_TTY=y
CONFIG_SERIAL_8250=y
CONFIG_SERIAL_8250_CONSOLE=y
CONFIG_SERIAL_8250_DW=y
CONFIG_SERIAL_8250_NR_UARTS=2
CONFIG_SERIAL_8250_RUNTIME_UARTS=2
CONFIG_SERIAL_OF_PLATFORM=y
CONFIG_SERIAL_EARLYCON=y

# Early printk for debugging
CONFIG_DEBUG_LL=y
CONFIG_EARLY_PRINTK=y
CONFIG_EARLY_PRINTK_DIRECT=y

# Minimal kernel features
CONFIG_PRINTK=y
CONFIG_BUG=y
CONFIG_EMBEDDED=y
CONFIG_EXPERT=y
CONFIG_MULTIUSER=n
CONFIG_SYSFS=y
CONFIG_PROC_FS=y
CONFIG_TMPFS=y

# No modules needed for minimal boot
CONFIG_MODULES=n

# No block layer needed for minimal boot
CONFIG_BLOCK=n

# No networking needed for minimal boot
CONFIG_NET=n

# Clocksource
CONFIG_CLKSRC_OF=y
CONFIG_CLKSRC_ARM_GLOBAL_TIMER_SCHED_CLOCK=y

# Generic kernel features
CONFIG_HZ_100=y
CONFIG_AEABI=y
CONFIG_GENERIC_IRQ_CHIP=y
CONFIG_IRQ_DOMAIN=y

# Keep it small
CONFIG_CC_OPTIMIZE_FOR_SIZE=y
CONFIG_SLOB=y

# Kernel compression
CONFIG_KERNEL_GZIP=y

# No initramfs
CONFIG_BLK_DEV_INITRD=n
CONFIG_SD5116_ETH=y
```
